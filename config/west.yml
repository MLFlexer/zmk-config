## config/west.yml
```yaml
manifest:
  remotes:
    - name: mlflexer_zmkfirmware
      url-base: https://github.com/mlflexer
  projects:
    - name: zmk
      remote: mlflexer_zmkfirmware
      revision: main
      import: app/west.yml
  self:
    path: config
```
